## meta-cmf-gx-restricted/conf/layer.conf
```bitbake
BBPATH .= ":${LAYERDIR}"
BBFILES += "\
            ${LAYERDIR}/meta*/recipes-*/*/*.bb \
            ${LAYERDIR}/meta*/recipes-*/*/*.bbappend \
            ${LAYERDIR}/recipes-*/*/*.bb \
            ${LAYERDIR}/recipes-*/*/*.bbappend \
           "

BBFILE_COLLECTIONS += "cmf-gx-restricted"
BBFILE_PATTERN_cmf-gx-restricted := "^${LAYERDIR}/"

LAYERSERIES_COMPAT_cmf-gx-restricted = "dunfell"

LAYERDEPENDS_cmf-gx-restricted = "cmf-gx"
```

## meta-cmf-gx/conf/layer.conf
```bitbake
BBPATH .= ":${LAYERDIR}"
BBFILES += "\
            ${LAYERDIR}/meta*/recipes-*/*/*.bb \
            ${LAYERDIR}/meta*/recipes-*/*/*.bbappend \
            ${LAYERDIR}/recipes-*/*/*.bb \
            ${LAYERDIR}/recipes-*/*/*.bbappend \
           "

BBFILE_COLLECTIONS += "cmf-gx"
BBFILE_PATTERN_cmf-gx := "^${LAYERDIR}/"
#BBFILE_PRIORITY_cmf-gx = "24"

LAYERSERIES_COMPAT_cmf-gx = "dunfell"

# do not error out on bbappends for missing recipes (mysql5)
#BB_DANGLINGAPPENDS_WARNONLY = "true"

LAYERDEPENDS_cmf-gx = "${@' cmf-broadband' if "broadband" in d.getVar('MACHINEOVERRIDES', True) else 'cmf cmf-video'}"

LAYERDEPENDS_cmf-gx_append = "${@' camera cmf-camera' if ("camera" in d.getVar('MACHINEOVERRIDES', True)) else ' '}"

LAYERDEPENDS_cmf-gx_append = " gx"

require conf/distro/include/rdk-rpi.inc
require conf/include/rdk-external-src-platform.inc

include include/rdk-bbmasks-rdkv-platform.inc

# RDK RPI builds include gstreamer ugly plugins
LICENSE_FLAGS_WHITELIST += "commercial_gstreamer1.0-plugins-ugly"
```

## meta-cmf-gx/conf/machine/sirius-rdk-hybrid.conf
```bitbake
#@TYPE: Machine
#@NAME: sirius-rdk-hybrid
#@NEEDED_BSPLAYERS: meta-gx
#@DESCRIPTION: Machine configuration for running a RDK media server (hybrid) on 32bit Raspberry Pi4
#@RDK_FLAVOR: rdkv

require conf/machine/sirius.conf

MACHINEOVERRIDES .= ":sirius:rpi:hybrid:wpe"

# required for image creation
MACHINE_IMAGE_NAME = "rdk-generic-hybrid-wpe-image"

DISTRO_FEATURES_append = " wifi"
DISTRO_FEATURES_append = " bluetooth"
DISTRO_FEATURES_append = " bluez5"
DISTRO_FEATURES_append = " rdkshell offline_apps"
DISTRO_FEATURES_append = " cobalt-plugin"
# no more onscreen terminal required for RDK services
DISTRO_FEATURES_append = " systemd-disable-getty"
# for spark
DISTRO_FEATURES_append = " spark"
```

## meta-cmf/conf/distro/include/rdkcmf.inc
```bitbake
BBMASK .= "|meta-rdk/recipes-extended/jquery/"

MAINTAINER = "RDK CMF Team <support@rdkcentral.com>"

PREFERRED_VERSION_breakpad = "git"
PREFERRED_PROVIDER_curl ?= "curl"
```

## meta-cmf/conf/layer.conf
```bitbake
BBPATH .= ":${LAYERDIR}"

BBFILES += "\
            ${LAYERDIR}/recipes-*/*/*.bb \
            ${LAYERDIR}/recipes-*/*/*/*.bb \
            ${LAYERDIR}/recipes-*/*/*.bbappend \
            ${LAYERDIR}/recipes-*/*/*/*.bbappend \
           "

BBFILE_COLLECTIONS += "cmf"
BBFILE_PATTERN_cmf := "^${LAYERDIR}/"
#BBFILE_PRIORITY_cmf = "25"

LAYERSERIES_COMPAT_cmf = "dunfell"

# Additional license directories.
LICENSE_PATH += "${LAYERDIR}/licenses"

LAYERDEPENDS_cmf = "rdk"

RDK_ROOT_PATH = "${LAYERDIR}/.."

require conf/distro/include/rdkcmf.inc
require conf/distro/include/rdk-external-src.inc
require conf/distro/include/rdk-versions.inc

PREFERRED_PROVIDER_virtual/samplemedia ?= "linaro-samplemedia"
PREFERRED_VERSION_lighttpd = "1.4.39"
PREFERRED_VERSION_xfsprogs_morty = "4.8.0"

# gmp 4.2.1 is the last version released as LGPLv2
# nettle 2.7.1 is the last version released as LGPLv2
# gnutls 3.3.x is the last branch which supports nettle 2.7.1
PREFERRED_VERSION_gmp_morty = "4.2.1"
PREFERRED_VERSION_nettle_morty = "2.7.1"
PREFERRED_VERSION_gnutls_morty = "3.3.%"

#Temporary bbmasks for components that have not been opensourced yet
BBMASK .= "|meta-rdk-video/recipes-extended/clnl/"

# There are two copies of bluez in openembedded-core and meta-rdk-ext, 
# masking the one in openembedded-core
BBMASK .= "|meta/recipes-connectivity/bluez5/"

DISTRO_FEATURES_append_arm = " ld-is-gold"
DISTRO_FEATURES_append_x86 = " ld-is-gold"
DISTRO_FEATURES_append_dunfell = " dunfell"
DISTRO_FEATURES_append_dunfell = " virtualization"
DISTRO_FEATURES_append_dunfell = " ssl-1.1.1"
```

## meta-gx/conf/layer.conf
```bitbake
# We have a conf and classes directory, append to BBPATH
BBPATH .= ":${LAYERDIR}"

# We have a recipes directory containing .bb and .bbappend files, add to BBFILES
BBFILES += "${LAYERDIR}/recipes*/*/*.bb \
            ${LAYERDIR}/recipes*/*/*.bbappend"

BBFILE_COLLECTIONS += "gx"
BBFILE_PATTERN_gx := "^${LAYERDIR}/"
BBFILE_PRIORITY_gx = "9"

LAYERSERIES_COMPAT_gx = "dunfell"

LAYERDEPENDS_gx = "core"

# Additional license directories.
LICENSE_PATH += "${LAYERDIR}/files/custom-licenses"

# The dynamic-layers directory hosts the extensions and layer specific
# modifications.
#
# The .bbappend and .bb files are included if the respective layer
# collection is available.
BBFILES += "${@' '.join('${LAYERDIR}/dynamic-layers/%s/recipes*/*/*.bbappend' % layer \
               for layer in BBFILE_COLLECTIONS.split())}"
BBFILES += "${@' '.join('${LAYERDIR}/dynamic-layers/%s/recipes*/*/*.bb' % layer \
               for layer in BBFILE_COLLECTIONS.split())}"

BBFILES_DYNAMIC += " \
    openembedded-layer:${LAYERDIR}/dynamic-layers/openembedded-layer/*/*/*.bb \
    openembedded-layer:${LAYERDIR}/dynamic-layers/openembedded-layer/*/*/*.bbappend \
    networking-layer:${LAYERDIR}/dynamic-layers/networking-layer/*/*/*.bb \
    networking-layer:${LAYERDIR}/dynamic-layers/networking-layer/*/*/*.bbappend \
    qt5-layer:${LAYERDIR}/dynamic-layers/qt5-layer/*/*/*.bb \
    qt5-layer:${LAYERDIR}/dynamic-layers/qt5-layer/*/*/*.bbappend \
"

DEFAULT_TEST_SUITES_remove_rpi = "parselogs"
DEFAULT_TEST_SUITES_append_rpi = " parselogs_rpi"
```

## meta-gx/conf/machine/include/rpi-base.inc
```bitbake
include conf/machine/include/rpi-default-settings.inc
include conf/machine/include/rpi-default-versions.inc
include conf/machine/include/rpi-default-providers.inc

SOC_FAMILY = "rpi"
include conf/machine/include/soc-family.inc

IMAGE_FSTYPES ?= "tar.bz2 ext3 wic.bz2 wic.bmap"
WKS_FILE ?= "sdimage-gx.wks"

XSERVER = " \
    xserver-xorg \
    ${@bb.utils.contains("MACHINE_FEATURES", "vc4graphics", "xserver-xorg-extension-glx", "", d)} \
    ${@bb.utils.contains("MACHINE_FEATURES", "vc4graphics", "xf86-video-modesetting", "xf86-video-fbdev", d)} \
    "

RPI_KERNEL_DEVICETREE ?= " \
    sirius_generic.dtb \
    "

KERNEL_DEVICETREE ?= " \
    ${RPI_KERNEL_DEVICETREE} \
    "

# By default:
#
# * When u-boot is disabled use the "Image" format which can be directly loaded
#   by the rpi firmware.
#
# * When u-boot is enabled use the "uImage" format and the "bootm" command
#   within u-boot to load the kernel.
KERNEL_BOOTCMD ??= "bootm"
KERNEL_IMAGETYPE_UBOOT ??= "uImage"
KERNEL_IMAGETYPE_DIRECT ??= "zImage"
KERNEL_IMAGETYPE ?= "${@bb.utils.contains('RPI_USE_U_BOOT', '1', \
        '${KERNEL_IMAGETYPE_UBOOT}', '${KERNEL_IMAGETYPE_DIRECT}', d)}"

MACHINE_FEATURES += "apm usbhost keyboard vfat ext2 screen touchscreen alsa bluetooth wifi sdio ${@bb.utils.contains('DISABLE_VC4GRAPHICS', '1', '', 'vc4graphics', d)}"

# Raspberry Pi has no hardware clock
MACHINE_FEATURES_BACKFILL_CONSIDERED = "rtc"

MACHINE_EXTRA_RRECOMMENDS += "kernel-modules udev-rules-rpi"
MACHINE_ESSENTIAL_EXTRA_RRECOMMENDS += "${@oe.utils.conditional('ENABLE_I2C', '1', 'kernel-module-i2c-dev kernel-module-i2c-bcm2708', '', d)}"
MACHINE_ESSENTIAL_EXTRA_RRECOMMENDS += "${@oe.utils.conditional('ENABLE_IR', '1', 'kernel-module-gpio-ir kernel-module-gpio-ir-tx', '', d)}"

SERIAL_CONSOLES_CHECK ??= "${SERIAL_CONSOLES}"

# The name of the deploy directory for raspberry pi boot files.
# This variable is referred to by recipes fetching / generating the files.
BOOTFILES_DIR_NAME ?= "bootfiles"

# Set Raspberrypi splash image
SPLASH = "psplash-gx"

def make_dtb_boot_files(d):
    # Generate IMAGE_BOOT_FILES entries for device tree files listed in
    # KERNEL_DEVICETREE.
    alldtbs = d.getVar('KERNEL_DEVICETREE')
    imgtyp = d.getVar('KERNEL_IMAGETYPE')

    def transform(dtb):
        base = os.path.basename(dtb)
        if dtb.endswith('dtb'):
            # eg: whatever/bcm2708-rpi-b.dtb has:
            #     DEPLOYDIR file: bcm2708-rpi-b.dtb
            #     destination: bcm2708-rpi-b.dtb
            return base
        elif dtb.endswith('dtbo'):
            # overlay dtb:
            # eg: overlays/hifiberry-amp.dtbo has:
            #     DEPLOYDIR file: hifiberry-amp.dtbo
            #     destination: overlays/hifiberry-amp.dtbo
            return '{};{}'.format(base, dtb)

    return ' '.join([transform(dtb) for dtb in alldtbs.split(' ') if dtb])


IMAGE_BOOT_FILES ?= "${BOOTFILES_DIR_NAME}/* \
                 ${@make_dtb_boot_files(d)} \
                 ${@bb.utils.contains('RPI_USE_U_BOOT', '1', \
                    '${KERNEL_IMAGETYPE} u-boot.bin;${SDIMG_KERNELIMAGE} boot.scr', \
                    '${KERNEL_IMAGETYPE};${SDIMG_KERNELIMAGE}', d)} \
                 "
do_image_wic[depends] += " \
    bootfiles:do_deploy \
    ${@bb.utils.contains('RPI_USE_U_BOOT', '1', 'u-boot:do_deploy', '',d)} \
    "

do_image_wic[recrdeps] = "do_build"

# The kernel image is installed into the FAT32 boot partition and does not need
# to also be installed into the rootfs.
RDEPENDS_${KERNEL_PACKAGE_NAME}-base = ""
```
